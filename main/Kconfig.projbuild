## main/Kconfig.projbuild
```kconfig
menu "Exercise Touchscreen"

config EXERCISE_WIFI_SSID
    string "Wi-Fi SSID"
    default ""

config EXERCISE_WIFI_PASSWORD
    string "Wi-Fi password"
    default ""

config EXERCISE_API_URL
    string "Dashboard API URL"
    default "http://192.168.1.208:8003/api/widgets/pullups"

config EXERCISE_API_TIMEZONE
    string "API timezone header"
    default "America/Halifax"

config EXERCISE_API_REFRESH_MS
    int "API refresh interval (ms)"
    range 1000 3600000
    default 60000

endmenu
```

## sdkconfig.defaults
```kconfig
CONFIG_PARTITION_TABLE_CUSTOM=y
CONFIG_PARTITION_TABLE_CUSTOM_FILENAME="partitions.csv"

CONFIG_ESP32S3_SPIRAM_SUPPORT=y
CONFIG_SPIRAM=y
# CONFIG_SPIRAM_MODE_QUAD is not set
CONFIG_SPIRAM_MODE_OCT=y
CONFIG_SPIRAM_TYPE_AUTO=y
# CONFIG_SPIRAM_SPEED_120M is not set
# CONFIG_SPIRAM_SPEED_80M is not set
CONFIG_SPIRAM_SPEED_40M=y
CONFIG_SPIRAM_SPEED=40
CONFIG_SPIRAM_BOOT_INIT=y
# CONFIG_SPIRAM_IGNORE_NOTFOUND is not set
CONFIG_SPIRAM_USE_MALLOC=y
CONFIG_SPIRAM_MEMTEST=y
CONFIG_SPIRAM_MALLOC_ALWAYSINTERNAL=16384
CONFIG_SPIRAM_MALLOC_RESERVE_INTERNAL=32768

CONFIG_ESP_MAIN_TASK_STACK_SIZE=8192
CONFIG_MAIN_TASK_STACK_SIZE=8192
CONFIG_ESP_SYSTEM_EVENT_TASK_STACK_SIZE=4096
CONFIG_SYSTEM_EVENT_TASK_STACK_SIZE=4096
CONFIG_ESP_TASK_WDT_TIMEOUT_S=20
# CONFIG_ESP_TASK_WDT_CHECK_IDLE_TASK_CPU0 is not set
CONFIG_TASK_WDT_TIMEOUT_S=20
# CONFIG_TASK_WDT_CHECK_IDLE_TASK_CPU0 is not set
CONFIG_TASK_WDT_CHECK_IDLE_TASK_CPU1=y

CONFIG_ESP_PANEL_DRIVERS_FILE_SKIP=y
CONFIG_ESP_PANEL_BOARD_FILE_SKIP=y

CONFIG_ESP_PANEL_BOARD_DEFAULT_USE_SUPPORTED=y
CONFIG_ESP_PANEL_BOARD_MANUFACTURER_VIEWE=y
CONFIG_BOARD_VIEWE_UEDX80480070E_WB_A=y
```
